## app/Kconfig
```kconfig
menuconfig LED_SUBSYSTEM
    bool "LED Subsystem"
    default y

if LED_SUBSYSTEM

choice
    prompt "LED blink sleep time"
    default BLINK_SLEEP_1000MS

config BLINK_SLEEP_250MS
    bool "Very Fast (250ms)"

config BLINK_SLEEP_500MS
    bool "Fast (500ms)"

config BLINK_SLEEP_1000MS
    bool "Medium (1s)"

config BLINK_SLEEP_2000MS
    bool "Slow (2s)"
endchoice

config BLINK_SLEEP_TIME_MS
    int
    default 250 if BLINK_SLEEP_250MS
    default 500 if BLINK_SLEEP_500MS
    default 1000 if BLINK_SLEEP_1000MS
    default 2000 if BLINK_SLEEP_2000MS
    default 0

menuconfig LED_ADVANCED
    bool "Advanced LED settings"
    default y

if LED_ADVANCED

config LED_BRIGHTNESS
    int "LED brightness (0-100)"
    default 100
    range 0 100

config LED_FADE
    int "LED fade duration (ms)"
    default 500
    range 0 5000





menu "Expert settings"
visible if LED_ADVANCED

config LED_DEBUGGING
    bool "Enable LED debugging"
    default n
config LED_CUSTOM_PATTERN
    bool "Custom blink pattern"
    default n
endmenu # "Expert settings"
endif # LED_ADVANCED

endif # LED_SUBSYSTEM


source "Kconfig.zephyr"
```
